## config/west.yml
```yaml
manifest:
  remotes:
    - name: zmkfirmware
      url-base: https://github.com/zmkfirmware
    - name: caksoylar
      url-base: https://github.com/caksoylar
    - name: razilyis
      url-base: https://github.com/razilyis
    - name: badjeff
      url-base: https://github.com/badjeff
    - name: te9no
      url-base: https://github.com/te9no
    - name: kot149
      url-base: https://github.com/kot149
    - name: mctechnology17
      url-base: https://github.com/mctechnology17
    - name: petejohanson
      url-base: https://github.com/petejohanson
    - name: TouchPass
      url-base: https://github.com/razilyis
  projects:
    - name: zmk
      remote: zmkfirmware
      revision: v0.3-branch
      import: app/west.yml

    - name: zmk-rgbled-widget
      remote: caksoylar
      revision: v0.3-branch

    - name: zmk-pmw3610-driver
      remote: razilyis
      revision: dev-v0.3_against-runaway

    - name: zmk-analog-input-driver
      remote: badjeff
      revision: main

    - name: zmk-nice-oled
      remote: mctechnology17
      revision: main

    # - name: zmk-layout-shift
    #   remote: kot149
    #   revision: v1

    - name: zmk-input-processor-keybind
      remote: te9no
      revision: main

    - name: cirque-input-module
      remote: petejohanson
      revision: main

    - name: zmk-driver-MLX90393
      remote: te9no
      revision: main
      
    - name: zmk-module-Fingerprint
      remote: TouchPass
      revision: main

  self:
    path: config
```
